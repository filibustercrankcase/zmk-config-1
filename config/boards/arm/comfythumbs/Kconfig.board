## config/boards/arm/comfythumbs/Kconfig.board
```kconfig
#
# Copyright (c) 2021 Malakai King
# SPDX-License-Identifier: MIT
#

config BOARD_COMFYTHUMBS_LEFT
	bool "comfythumbs_left"
	depends on SOC_NRF52840_QIAA

config BOARD_COMFYTHUMBS_RIGHT
	bool "comfythumbs_right"
	depends on SOC_NRF52840_QIAA
```

## config/boards/arm/comfythumbs/Kconfig.defconfig
```kconfig
#
# Copyright (c) 2021 Malakai King
# SPDX-License-Identifier: MIT
#

if BOARD_COMFYTHUMBS_LEFT

	config ZMK_KEYBOARD_NAME
	default "ComfyThumbs"

endif # BOARD_COMFYTHUMBS_LEFT

if BOARD_COMFYTHUMBS_RIGHT

	config ZMK_KEYBOARD_NAME
	default "ComfyThumbs rt"

endif # BOARD_COMFYTHUMBS_RIGHT


if BOARD_COMFYTHUMBS_LEFT || BOARD_COMFYTHUMBS_RIGHT

config BOARD
	default "comfythumbs"

config ZMK_SPLIT
	default y

config BT_CTLR
	default BT

config ZMK_BLE
	default y

config ZMK_USB
	default y

config ZMK_BATTERY_VOLTAGE_DIVIDER
	default y

if USB

config USB_NRFX
	default y

config USB_DEVICE_STACK
	default y

endif # USB

endif # BOARD_COMFYTHUMBS_LEFT || BOARD_COMFYTHUMBS_RIGHT
```
