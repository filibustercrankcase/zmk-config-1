/*
*
* Copyright (c) 2021 Malakai King
* SPDX-License-Identifier: MIT
*
*/

#include "comfythumbs.dtsi"

/{
	sensors {
		compatible = "zmk,keymap-sensors";
		sensors = <&left_encoder>;
	};
	kscan0: kscan {
		compatible = "zmk,kscan-gpio-matrix";
		label = "KSCAN";

		diode-direction = "col2row";
		row-gpios
			= <&gpio1  0 (GPIO_ACTIVE_HIGH | GPIO_PULL_DOWN)>
			, <&gpio1  3 (GPIO_ACTIVE_HIGH | GPIO_PULL_DOWN)>
			, <&gpio1  1 (GPIO_ACTIVE_HIGH | GPIO_PULL_DOWN)>
			, <&gpio0 29 (GPIO_ACTIVE_HIGH | GPIO_PULL_DOWN)>
			, <&gpio0 31 (GPIO_ACTIVE_HIGH | GPIO_PULL_DOWN)>
			, <&gpio0 10 (GPIO_ACTIVE_HIGH | GPIO_PULL_DOWN)>
			, <&gpio1  9 (GPIO_ACTIVE_HIGH | GPIO_PULL_DOWN)>
			, <&gpio0 28 (GPIO_ACTIVE_HIGH | GPIO_PULL_DOWN)>
			, <&gpio0  3 (GPIO_ACTIVE_HIGH | GPIO_PULL_DOWN)>
			;

		col-gpios
			= <&gpio0  2 GPIO_ACTIVE_HIGH>
			, <&gpio1 13 GPIO_ACTIVE_HIGH>
			, <&gpio0 21 GPIO_ACTIVE_HIGH>
			, <&gpio0 23 GPIO_ACTIVE_HIGH>
			, <&gpio0 12 GPIO_ACTIVE_HIGH>
			, <&gpio1 11 GPIO_ACTIVE_HIGH>
			, <&gpio1 10 GPIO_ACTIVE_HIGH>
			, <&gpio0 30 GPIO_ACTIVE_HIGH>
			, <&gpio0 19 GPIO_ACTIVE_HIGH>
			, <&gpio0 22 GPIO_ACTIVE_HIGH>
			, <&gpio0  9 GPIO_ACTIVE_HIGH>
			, <&gpio1  6 GPIO_ACTIVE_HIGH>
			;
	};

	left_encoder: encoder_left {
		compatible = "alps,ec11";
		label = "LEFT_ENCODER";
		a-gpios = <&gpio1 4 (GPIO_ACTIVE_HIGH | GPIO_PULL_UP)>;
		b-gpios = <&gpio1 2 (GPIO_ACTIVE_HIGH | GPIO_PULL_UP)>;
 		resolution = <2>;
    	};
};

&left_encoder {
    status = "okay";
};
